## Node_ESP32_BLT/sdkconfig.defaults
```kconfig
# CONFIG_SECURE_FLASH_ENC_ENABLED=y
# CONFIG_SECURE_FLASH_ENCRYPTION_MODE_DEVELOPMENT=y


CONFIG_BT_ENABLED=y
CONFIG_BT_BLUEDROID_ENABLED=y
CONFIG_BTDM_CTRL_MODE_BTDM=y
CONFIG_ESP32_WIFI_SW_COEXIST_ENABLE=y

CONFIG_FREERTOS_HZ=1000
```
